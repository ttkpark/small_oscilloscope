## sdkconfig.defaults
```kconfig
# ESP32 basic settings
CONFIG_ESP_DEFAULT_CPU_FREQ_MHZ_240=y
CONFIG_SPIRAM=y

# Logging settings
CONFIG_LOG_DEFAULT_LEVEL_INFO=y
CONFIG_LOG_MAXIMUM_LEVEL_VERBOSE=y

# FreeRTOS settings
CONFIG_FREERTOS_HZ=1000

# ADC settings
CONFIG_ADC_CAL_EFUSE_TP_ENABLE=y
CONFIG_ADC_CAL_EFUSE_VREF_ENABLE=y

# GPIO settings
CONFIG_GPIO_ESP32_SUPPORT_SWITCH_SLP_PULL=y

# Memory settings
CONFIG_SPIRAM_USE_MALLOC=y
CONFIG_SPIRAM_MEMTEST=y 
```
